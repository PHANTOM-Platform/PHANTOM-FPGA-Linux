## buildroot-phantom/configs/phantom_zynq_defconfig
```kconfig
BR2_arm=y
BR2_cortex_a9=y
BR2_ARM_ENABLE_NEON=y
BR2_ARM_ENABLE_VFP=y
BR2_TARGET_GENERIC_GETTY_PORT="ttyPS0"
BR2_TARGET_ROOTFS_TAR=n
BR2_TARGET_ROOTFS_CPIO=y
BR2_TARGET_ROOTFS_CPIO_GZIP=y
BR2_TARGET_ROOTFS_CPIO_UIMAGE=y
BR2_TARGET_UBOOT=n
BR2_LINUX_KERNEL=n

#
# Use an external (e.g. Xilinx) toolchain, instead of generating one
#
BR2_TOOLCHAIN_EXTERNAL=y
BR2_TOOLCHAIN_EXTERNAL_CUSTOM=y
BR2_TOOLCHAIN_EXTERNAL_PREINSTALLED=y
BR2_TOOLCHAIN_EXTERNAL_CUSTOM_PREFIX="arm-linux-gnueabihf"
BR2_TOOLCHAIN_EXTERNAL_GCC_6=y
BR2_TOOLCHAIN_EXTERNAL_HEADERS_4_9=y
BR2_TOOLCHAIN_EXTERNAL_CUSTOM_GLIBC=y
BR2_TOOLCHAIN_EXTERNAL_HAS_SSP=y
BR2_TOOLCHAIN_EXTERNAL_INET_RPC=y
BR2_TOOLCHAIN_EXTERNAL_CXX=y

#
# Customise the distribution
#
BR2_TARGET_GENERIC_HOSTNAME="phantomfpga"
BR2_TARGET_GENERIC_ISSUE="PHANTOM FPGA Linux on Zynq-7000"
BR2_TARGET_GENERIC_ROOT_PASSWD="phantom"

#
# Enable DHCP on eth0
#
BR2_SYSTEM_DHCP="eth0"

#
# Optional packages to include
#
BR2_PACKAGE_OPENSSH=y

#
# Scripts, overlays, etc. for PHANTOM rootfs
#
BR2_ROOTFS_OVERLAY="$(BR2_EXTERNAL_PHANTOM_PATH)/board/phantom_zynq/overlay/"
BR2_ROOTFS_POST_BUILD_SCRIPT="$(BR2_EXTERNAL_PHANTOM_PATH)/board/phantom_zynq/post-build.sh"
```
